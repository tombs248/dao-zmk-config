## config/west.yml
```yaml
manifest:
  remotes:
    - name: zmkfirmware
      url-base: https://github.com/zmkfirmware
    - name: ergonautkb
      url-base: https://github.com/ergonautkb
    - name: zmklocales
      url-base: https://github.com/joelspadin
  projects:
    - name: zmk
      remote: zmkfirmware
      revision: main
      import: app/west.yml
    - name: ergonautkb-zmk-module
      remote: ergonautkb
      revision: main
    - name: zmk-locales
      remote: zmklocales
      revision: main
  self:
    path: config
```
